## sdkconfig.defaults
```kconfig
# Enable C++ exceptions and RTTI (required for standard C++ library features)
CONFIG_COMPILER_CXX_EXCEPTIONS=y
CONFIG_COMPILER_CXX_RTTI=y

# Give app_main a generous stack
CONFIG_ESP_MAIN_TASK_STACK_SIZE=4096
```

## sdkconfig.defaults.qemu
```kconfig
# sdkconfig.defaults.qemu
# Overlay applied on top of sdkconfig.defaults when building for QEMU emulation.
# DO NOT flash this configuration to real hardware — CONFIG_ETH_USE_OPENETH
# enables the OpenCores Ethernet driver which only exists inside QEMU.
#
# Applied by emulate.sh via:
#   idf.py -DSDKCONFIG_DEFAULTS="sdkconfig.defaults;sdkconfig.defaults.qemu"

# Enable the OpenCores Ethernet MAC emulated by QEMU via -nic user,model=open_eth
CONFIG_ETH_USE_OPENETH=y
```
